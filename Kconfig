## zephyr/Kconfig
```kconfig
config ZEPHYR_TMC_API_MODULE
	bool

config TMC_API
	bool "TMC API"
	help
	  This option enables the Trinamic API module.

menu "Trinamic API options"

if TMC_API

config TMC_RAMP
	bool "Support for TMC ramp"

config TMC_HELPERS
	bool "Support for TMC helpers"

config TMC_4671
	bool "Support for TMC4671 motor controller"
	select TMC_HELPERS

endif # TMC_API

endmenu
```
